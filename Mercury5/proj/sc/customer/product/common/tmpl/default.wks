## Mercury5/proj/sc/driver/drv/gop/Kconfig
```kconfig
config MS_FB
	tristate "FB driver"	
	default y
	select FB
	select FB_SYS_FILLRECT
    select FB_SYS_COPYAREA
    select FB_SYS_IMAGEBLIT
    select FB_SYS_FOPS
	help

config MS_FB_INFINITY
    tristate "FB driver support for iNfinity"
    depends on MS_FB
    depends on ARCH_INFINITY

config MS_FB_INFINITY3
    tristate "FB driver (GOP0) support for iNfinity3"
    depends on MS_FB
    depends on ARCH_INFINITY3

config MS_FB1_INFINITY3
    tristate "FB driver (GOP1) support for iNfinity3"
    depends on MS_FB
    depends on ARCH_INFINITY3

config MS_FB2_INFINITY3
    tristate "FB driver (GOP2) support for iNfinity3"
    depends on MS_FB
    depends on ARCH_INFINITY3
```

## Mercury5/proj/sc/driver/drv/hvd/Kconfig
```kconfig
config DRV_HVD

tristate "HVD"
default n

---help---
Enable compilation option for driver HVD
```
